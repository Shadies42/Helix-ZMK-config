## boards/shields/helix/Kconfig.defconfig
```kconfig
if SHIELD_HELIX

config ZMK_KEYBOARD_NAME
    default "helix"

config ZMK_SPLIT
    default y

config ZMK_SPLIT_ROLE_CENTRAL
    default n

endif

if SHIELD_HELIX_DONGLE

config ZMK_KEYBOARD_NAME
    default "helix_dongle"

config ZMK_SPLIT
    default y

config ZMK_SPLIT_ROLE_CENTRAL
    default y

endif
```

## boards/shields/helix/Kconfig.shield
```kconfig
config SHIELD_HELIX_DONGLE
    def_bool $(shields_list_contains,helix_dongle)
config SHIELD_HELIX
    def_bool $(shields_list_contains,helix)
```

## config/west.yml
```yaml
manifest:
  remotes:
    - name: zmkfirmware
      url-base: https://github.com/zmkfirmware
    - name: badjeff
      url-base: https://github.com/badjeff
    - name: george-norton
      url-base: https://github.com/george-norton
    - name: nrfconnect
      url-base: https://github.com/nrfconnect
  projects:
    # Base ZMK (badjeff fork, includes extra features you’ve been using)
    - name: zmk
      remote: badjeff
      revision: main
      import: app/west.yml

    # Sensor drivers
    - name: zmk-paw3395-driver
      remote: badjeff
      revision: main
    - name: zmk-pmw3610-driver
      remote: badjeff
      revision: main
    - name: zmk-behavior-sensor-attr-cycle
      remote: george-norton
      revision: main
    # Input processors / behaviors used in your keymap
    - name: zmk-input-processor-report-rate-limit
      remote: badjeff
      revision: main
    - name: zmk-behavior-mouse-key-toggle
      remote: badjeff
      revision: main
    # --- ESB Split Transport + NCS bits ---
    - name: zmk-feature-split-esb
      remote: badjeff
      revision: main
      
    - name: sdk-nrf
      remote: badjeff
      revision: v3.1-branch+zmk-fixes
      path: nrf

    - name: nrfxlib
      remote: nrfconnect
      revision: v3.1-branch
      repo-path: sdk-nrfxlib
      path: nrfxlib


  self:
    path: config
```
